## arch/arm/hotplug/Kconfig
```kconfig
config MSM_HOTPLUG
	bool "MSM hotplug driver"
	depends on HOTPLUG_CPU
	help
	  The MSM hotplug driver controls on-/offlining of additional cores based
	  on current cpu load
```

## drivers/cpufreq/Kconfig.rej
```kconfig
diff a/drivers/cpufreq/Kconfig b/drivers/cpufreq/Kconfig	(rejected hunks)
@@ -266,6 +266,11 @@ config CPU_FREQ_GOV_ADAPTIVE
 config CPU_FREQ_GOV_PEGASUSQ
 	tristate "'pegasusq' cpufreq policy governor"
 
+config CPU_FREQ_GOV_PEGASUSQ_BOOST
+	bool "pegasusq - enable suport for userspace-controlled cpu boosts"
+	depends on CPU_FREQ_GOV_PEGASUSQ
+	default n
+
 config CPU_FREQ_GOV_SLP
 	tristate "'slp' cpufreq policy governor"
 
```

## fs/sdcardfskk/Kconfig
```kconfig
config SDCARD_FS_KK
	tristate "sdcard file system"
	depends on EXPERIMENTAL && SDCARD_FS
	default n
	help
	  sdcardfskk is a sdcardfs dedicated for Android 4.4 KitKat
```

## kernel/Kconfig.hz
```kconfig
#
# Timer Interrupt Frequency Configuration
#

choice
	prompt "Timer frequency"

	config HZ_100
		bool "100 HZ"
	help
	  100 Hz is a typical choice for servers, SMP and NUMA systems
	  with lots of processors that may show reduced performance if
	  too many timer interrupts are occurring.

	config HZ_250
		bool "250 HZ"
	help
	 250 Hz is a good compromise choice allowing server performance
	 while also showing good interactive responsiveness even
	 on SMP and NUMA systems. If you are going to be using NTSC video
	 or multimedia, selected 300Hz instead.

	config HZ_300
		bool "300 HZ"
	help
	 300 Hz is a good compromise choice allowing server performance
	 while also showing good interactive responsiveness even
	 on SMP and NUMA systems and exactly dividing by both PAL and
	 NTSC frame rates for video and multimedia work.

	config HZ_432
		bool "432 HZ"

	config HZ_1000
		bool "1000 HZ"
	help
	 1000 Hz is the preferred choice for desktop systems and other
	 systems requiring fast interactive responses to events.

endchoice

config HZ
	int
	default 100 if HZ_100
	default 250 if HZ_250
	default 300 if HZ_300
	default 432 if HZ_432
	default 1000 if HZ_1000

config SCHED_HRTICK
	def_bool HIGH_RES_TIMERS && (!SMP || USE_GENERIC_SMP_HELPERS)
```

## kernel/time/Kconfig
```kconfig
#
# Timer subsystem related configuration options
#
config TICK_ONESHOT
	bool

config NO_HZ
	bool "Tickless System (Dynamic Ticks)"
	depends on !ARCH_USES_GETTIMEOFFSET && GENERIC_CLOCKEVENTS
	select TICK_ONESHOT
	help
	  This option enables a tickless system: timer interrupts will
	  only trigger on an as-needed basis both when the system is
	  busy and when the system is idle.

config NO_HZ_EXTENDED
       bool "Full dynticks system"
       depends on NO_HZ && SMP
       select CONTEXT_TRACKING_FORCE
       help
         Adaptively try to shutdown the tick whenever possible, even when
	 the CPU is running tasks. Typically this requires running a single
	 task on the CPU. Chances for running tickless are maximized when
	 the task mostly runs in userspace and has few kernel activity.

	 You need to fill up the nohz_extended boot parameter with the
	 desired range of dynticks CPUs.

	 This is implemented at the expense of some overhead in user <-> kernel
	 transitions: syscalls, exceptions and interrupts. Even when it's
	 dynamically off.

	 Say N.

config HIGH_RES_TIMERS
	bool "High Resolution Timer Support"
	depends on !ARCH_USES_GETTIMEOFFSET && GENERIC_CLOCKEVENTS
	select TICK_ONESHOT
	help
	  This option enables high resolution timer support. If your
	  hardware is not capable then this option only increases
	  the size of the kernel image.

config GENERIC_CLOCKEVENTS_BUILD
	bool
	default y
	depends on GENERIC_CLOCKEVENTS || GENERIC_CLOCKEVENTS_MIGR

# Selectable by architectures which want to reuse the clocksource as
# sched_clock
config HAVE_CLKSRC_SCHED_CLOCK
       bool
```
